## build/conf/bblayers.conf
```bitbake
# LAYER_CONF_VERSION is increased each time build/conf/bblayers.conf
# changes incompatibly
LCONF_VERSION = "6"

BBPATH = "${TOPDIR}"
BBFILES ?= ""

BBLAYERS ?= " \
  /home/alex/yocto/poky-fido/meta \
  /home/alex/yocto/poky-fido/meta-yocto \
  /home/alex/yocto/poky-fido/meta-yocto-bsp \
  "
BBLAYERS_NON_REMOVABLE ?= " \
  /home/alex/yocto/poky-fido/meta \
  /home/alex/yocto/poky-fido/meta-yocto \
  "
#added by hob
BBFILES += "${TOPDIR}/recipes/images/custom/*.bb"
#added by hob
BBFILES += "${TOPDIR}/recipes/images/*.bb"
```

## meta-yocto-bsp/conf/machine/genericx86.conf
```bitbake
#@TYPE: Machine
#@NAME: Generic X86.

#@DESCRIPTION: Machine configuration for generic X86 (32-bit) PCs. Supports a moderately wide range of drivers that should boot and be usable on "typical" hardware.

DEFAULTTUNE ?= "core2-32"
require conf/machine/include/tune-core2.inc
require conf/machine/include/genericx86-common.inc

SYSLINUX_OPTS = "serial 0 115200"
SERIAL_CONSOLE = "115200 ttyS0"

APPEND += "console=ttyS0,115200 console=tty0"
APPEND += "video=vesafb vga=0x318"
```
